## buildroot/configs/teslausb_neo_defconfig
```kconfig
# TeslaUSB Neo Buildroot defconfig for Raspberry Pi Zero 2 W
#
# Based on the upstream raspberrypizero2w_defconfig from Buildroot 2024.02
# with additions for: systemd, WiFi, exFAT, dm-snapshot, rsync, avahi, SSH

# ─── Architecture (from upstream) ───────────────────────
BR2_arm=y
BR2_cortex_a53=y
BR2_ARM_FPU_NEON_VFPV4=y

# ─── Toolchain (from upstream — internal, not Bootlin) ──
BR2_PACKAGE_HOST_LINUX_HEADERS_CUSTOM_6_1=y
BR2_TOOLCHAIN_BUILDROOT_CXX=y

# ─── System ─────────────────────────────────────────────
BR2_TARGET_GENERIC_HOSTNAME="teslausb"
BR2_TARGET_GENERIC_ISSUE="TeslaUSB Neo"
BR2_INIT_SYSTEMD=y
BR2_ROOTFS_OVERLAY="$(BR2_EXTERNAL_TESLAUSB_NEO_PATH)/board/teslausb/rootfs_overlay"
BR2_ROOTFS_POST_BUILD_SCRIPT="$(BR2_EXTERNAL_TESLAUSB_NEO_PATH)/board/teslausb/post-build.sh"
BR2_ROOTFS_POST_IMAGE_SCRIPT="$(BR2_EXTERNAL_TESLAUSB_NEO_PATH)/board/teslausb/post-image.sh"

# ─── Kernel (from upstream — RPi 6.1 series) ───────────
BR2_LINUX_KERNEL=y
BR2_LINUX_KERNEL_CUSTOM_TARBALL=y
BR2_LINUX_KERNEL_CUSTOM_TARBALL_LOCATION="$(call github,raspberrypi,linux,17f135b742c4edb340afb365873c3a574f7e16cb)/linux-17f135b742c4edb340afb365873c3a574f7e16cb.tar.gz"
BR2_LINUX_KERNEL_DEFCONFIG="bcm2709"
BR2_LINUX_KERNEL_DTS_SUPPORT=y
BR2_LINUX_KERNEL_INTREE_DTS_NAME="bcm2710-rpi-zero-2-w"
BR2_LINUX_KERNEL_NEEDS_HOST_OPENSSL=y
# Pin the runtime-required kernel options (USB gadget, exFAT, dm-snapshot,
# zram) so a successful build cannot ship a runtime-broken kernel. Verified
# post-build by scripts/check_kernel_config.py.
BR2_LINUX_KERNEL_CONFIG_FRAGMENT_FILES="$(BR2_EXTERNAL_TESLAUSB_NEO_PATH)/board/teslausb/linux.fragment"

# ─── Raspberry Pi firmware (from upstream) ──────────────
BR2_PACKAGE_RPI_FIRMWARE=y
BR2_PACKAGE_RPI_FIRMWARE_BOOTCODE_BIN=y
BR2_PACKAGE_RPI_FIRMWARE_VARIANT_PI=y
BR2_PACKAGE_RPI_FIRMWARE_CONFIG_FILE="$(BR2_EXTERNAL_TESLAUSB_NEO_PATH)/board/teslausb/config.txt"
# Install the precompiled DT overlays (needed for dtoverlay=dwc2 → USB gadget).
BR2_PACKAGE_RPI_FIRMWARE_INSTALL_DTB_OVERLAYS=y

# ─── WiFi firmware (REQUIRED — without this, no WiFi) ──
BR2_PACKAGE_BRCMFMAC_SDIO_FIRMWARE_RPI=y
BR2_PACKAGE_BRCMFMAC_SDIO_FIRMWARE_RPI_WIFI=y

# ─── WiFi management ───────────────────────────────────
# NetworkManager auto-selects wpa_supplicant, but we pin it (and the nl80211
# driver) explicitly: WiFi is load-bearing here, so the dependency should be
# visible rather than implicit.
BR2_PACKAGE_WPA_SUPPLICANT=y
BR2_PACKAGE_WPA_SUPPLICANT_NL80211=y
BR2_PACKAGE_NETWORKMANAGER=y

# ─── Time sync (REQUIRED — Pi Zero 2 W has no RTC) ─────
# Without NTP the clock boots at the epoch, which breaks TLS to ntfy/Apprise/
# Tessie ("certificate is not yet valid") and skews archive timestamps.
# post-build.sh enables the service; timesyncd persists last-known time.
BR2_PACKAGE_SYSTEMD_TIMESYNCD=y

# ─── mDNS (teslausb.local) ─────────────────────────────
BR2_PACKAGE_AVAHI=y
BR2_PACKAGE_AVAHI_DAEMON=y

# ─── Filesystem tools ──────────────────────────────────
BR2_PACKAGE_EXFATPROGS=y
# parted (+ partprobe) for first-boot creation of the cam/music/lightshow
# partitions (see teslausb-provision.service). systemd already forces a glibc
# toolchain, so parted's locale/wchar deps are satisfied.
BR2_PACKAGE_PARTED=y
BR2_PACKAGE_DOSFSTOOLS=y
BR2_PACKAGE_DOSFSTOOLS_FSCK_FAT=y
BR2_PACKAGE_DOSFSTOOLS_MKFS_FAT=y
BR2_PACKAGE_E2FSPROGS=y
BR2_PACKAGE_E2FSPROGS_FSCK=y
BR2_PACKAGE_UTIL_LINUX=y
BR2_PACKAGE_UTIL_LINUX_MOUNT=y
BR2_PACKAGE_UTIL_LINUX_LOSETUP=y
BR2_PACKAGE_UTIL_LINUX_FSTRIM=y
# sfdisk: writes the MBR + exFAT partition table the Tesla requires inside each
# cam/music/lightshow partition (see teslausb-provision.sh format_tesla_drive).
BR2_PACKAGE_UTIL_LINUX_FDISK=y

# ─── Device-mapper (for dm-snapshot + zram) ─────────────
BR2_PACKAGE_LVM2=y
BR2_PACKAGE_LVM2_DMSETUP=y

# ─── Archive tools ─────────────────────────────────────
BR2_PACKAGE_RSYNC=y

# ─── Kernel module tools (from upstream) ────────────────
BR2_PACKAGE_BUSYBOX_SHOW_OTHERS=y
BR2_PACKAGE_KMOD=y
BR2_PACKAGE_KMOD_TOOLS=y
BR2_PACKAGE_XZ=y
BR2_PACKAGE_HOST_KMOD_XZ=y

# ─── SSH (for remote access) ───────────────────────────
BR2_PACKAGE_OPENSSH=y

# ─── Root filesystem image ─────────────────────────────
BR2_TARGET_ROOTFS_EXT2=y
BR2_TARGET_ROOTFS_EXT2_4=y
BR2_TARGET_ROOTFS_EXT2_SIZE="200M"
# BR2_TARGET_ROOTFS_TAR is not set

# ─── Host tools for SD card image generation ───────────
BR2_PACKAGE_HOST_DOSFSTOOLS=y
BR2_PACKAGE_HOST_E2FSPROGS=y
BR2_PACKAGE_HOST_GENEXT2FS=y
BR2_PACKAGE_HOST_GENIMAGE=y
BR2_PACKAGE_HOST_MTOOLS=y

# ─── Build optimization ───────────────────────────────
BR2_CCACHE=y
```

## buildroot/package/teslausb/Config.in
```kconfig
config BR2_PACKAGE_TESLAUSB
	bool "teslausb"
	help
	  TeslaUSB Neo daemon. Single Go binary that manages USB
	  mass storage gadget, WiFi archiving, web UI, notifications,
	  and health monitoring for Tesla dashcam.
	  https://github.com/ejaramilla/teslausb-neo
```
